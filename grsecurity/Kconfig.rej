## grsecurity/Kconfig.rej
```kconfig
--- grsecurity/Kconfig	2012-10-13 09:51:35.000000000 -0400
+++ grsecurity/Kconfig	2012-10-13 09:52:32.000000000 -0400
@@ -621,7 +621,7 @@
 config GRKERNSEC_AUDIT_GID
 	int "GID for auditing"
 	depends on GRKERNSEC_AUDIT_GROUP
-	default 1007
+	default 100
 
 config GRKERNSEC_EXECLOG
 	bool "Exec logging"
@@ -848,7 +848,7 @@
 config GRKERNSEC_TPE_UNTRUSTED_GID
 	int "GID for TPE-untrusted users"
 	depends on GRKERNSEC_TPE && !GRKERNSEC_TPE_INVERT
-	default 1005
+	default 100
 	help
 	  Setting this GID determines what group TPE restrictions will be
 	  *enabled* for.  If the sysctl option is enabled, a sysctl option
@@ -857,7 +857,7 @@
 config GRKERNSEC_TPE_TRUSTED_GID
 	int "GID for TPE-trusted users"
 	depends on GRKERNSEC_TPE && GRKERNSEC_TPE_INVERT
-	default 1005
+	default 10
 	help
 	  Setting this GID determines what group TPE restrictions will be
 	  *disabled* for.  If the sysctl option is enabled, a sysctl option
@@ -950,7 +950,7 @@
 config GRKERNSEC_SOCKET_ALL_GID
 	int "GID to deny all sockets for"
 	depends on GRKERNSEC_SOCKET_ALL
-	default 1004
+	default 65534
 	help
 	  Here you can choose the GID to disable socket access for. Remember to
 	  add the users you want socket access disabled for to the GID
@@ -971,7 +971,7 @@
 config GRKERNSEC_SOCKET_CLIENT_GID
 	int "GID to deny client sockets for"
 	depends on GRKERNSEC_SOCKET_CLIENT
-	default 1003
+	default 65534
 	help
 	  Here you can choose the GID to disable client socket access for.
 	  Remember to add the users you want client socket access disabled for to
@@ -989,7 +989,7 @@
 config GRKERNSEC_SOCKET_SERVER_GID
 	int "GID to deny server sockets for"
 	depends on GRKERNSEC_SOCKET_SERVER
-	default 1002
+	default 65534
 	help
 	  Here you can choose the GID to disable server socket access for.
 	  Remember to add the users you want server socket access disabled for to
```
